// Generated by PeakRDL-regblock - A free and open-source SystemVerilog generator
//  https://github.com/SystemRDL/PeakRDL-regblock

module tcp_stream_regs (
        input wire clk,
        input wire rst,

        input wire s_cpuif_req,
        input wire s_cpuif_req_is_wr,
        input wire [5:0] s_cpuif_addr,
        input wire [31:0] s_cpuif_wr_data,
        input wire [31:0] s_cpuif_wr_biten,
        output wire s_cpuif_req_stall_wr,
        output wire s_cpuif_req_stall_rd,
        output wire s_cpuif_rd_ack,
        output wire s_cpuif_rd_err,
        output wire [31:0] s_cpuif_rd_data,
        output wire s_cpuif_wr_ack,
        output wire s_cpuif_wr_err,

        input tcp_stream_regs_pkg::tcp_stream_regs__in_t hwif_in,
        output tcp_stream_regs_pkg::tcp_stream_regs__out_t hwif_out
    );

    //--------------------------------------------------------------------------
    // CPU Bus interface logic
    //--------------------------------------------------------------------------
    logic cpuif_req;
    logic cpuif_req_is_wr;
    logic [5:0] cpuif_addr;
    logic [31:0] cpuif_wr_data;
    logic [31:0] cpuif_wr_biten;
    logic cpuif_req_stall_wr;
    logic cpuif_req_stall_rd;

    logic cpuif_rd_ack;
    logic cpuif_rd_err;
    logic [31:0] cpuif_rd_data;

    logic cpuif_wr_ack;
    logic cpuif_wr_err;

    assign cpuif_req = s_cpuif_req;
    assign cpuif_req_is_wr = s_cpuif_req_is_wr;
    assign cpuif_addr = s_cpuif_addr;
    assign cpuif_wr_data = s_cpuif_wr_data;
    assign cpuif_wr_biten = s_cpuif_wr_biten;
    assign s_cpuif_req_stall_wr = cpuif_req_stall_wr;
    assign s_cpuif_req_stall_rd = cpuif_req_stall_rd;
    assign s_cpuif_rd_ack = cpuif_rd_ack;
    assign s_cpuif_rd_err = cpuif_rd_err;
    assign s_cpuif_rd_data = cpuif_rd_data;
    assign s_cpuif_wr_ack = cpuif_wr_ack;
    assign s_cpuif_wr_err = cpuif_wr_err;

    logic cpuif_req_masked;
    logic external_req;
    logic external_pending;
    logic external_wr_ack;
    logic external_rd_ack;
    always_ff @(posedge clk) begin
        if(rst) begin
            external_pending <= '0;
        end else begin
            if(external_req & ~external_wr_ack & ~external_rd_ack) external_pending <= '1;
            else if(external_wr_ack | external_rd_ack) external_pending <= '0;
            assert(!external_wr_ack || (external_pending | external_req))
                else $error("An external wr_ack strobe was asserted when no external request was active");
            assert(!external_rd_ack || (external_pending | external_req))
                else $error("An external rd_ack strobe was asserted when no external request was active");
        end
    end

    // Read & write latencies are balanced. Stalls not required
    // except if external
    assign cpuif_req_stall_rd = external_pending;
    assign cpuif_req_stall_wr = external_pending;
    assign cpuif_req_masked = cpuif_req
                            & !(!cpuif_req_is_wr & cpuif_req_stall_rd)
                            & !(cpuif_req_is_wr & cpuif_req_stall_wr);

    //--------------------------------------------------------------------------
    // Address Decode
    //--------------------------------------------------------------------------
    typedef struct {
        logic source_port;
        logic source_ip;
        logic dest_port;
        logic dest_ip;
        logic control;
        logic m2s_dma_regs;
    } decoded_reg_strb_t;
    decoded_reg_strb_t decoded_reg_strb;
    logic decoded_strb_is_external;

    logic [5:0] decoded_addr;

    logic decoded_req;
    logic decoded_req_is_wr;
    logic [31:0] decoded_wr_data;
    logic [31:0] decoded_wr_biten;

    always_comb begin
        automatic logic is_external;
        is_external = '0;
        decoded_reg_strb.source_port = cpuif_req_masked & (cpuif_addr == 6'h0);
        decoded_reg_strb.source_ip = cpuif_req_masked & (cpuif_addr == 6'h4);
        decoded_reg_strb.dest_port = cpuif_req_masked & (cpuif_addr == 6'h8);
        decoded_reg_strb.dest_ip = cpuif_req_masked & (cpuif_addr == 6'hc);
        decoded_reg_strb.control = cpuif_req_masked & (cpuif_addr == 6'h10);
        decoded_reg_strb.m2s_dma_regs = cpuif_req_masked & (cpuif_addr >= 6'h20) & (cpuif_addr <= 6'h20 + 6'hf);
        is_external |= cpuif_req_masked & (cpuif_addr >= 6'h20) & (cpuif_addr <= 6'h20 + 6'hf);
        decoded_strb_is_external = is_external;
        external_req = is_external;
    end

    // Pass down signals to next stage
    assign decoded_addr = cpuif_addr;

    assign decoded_req = cpuif_req_masked;
    assign decoded_req_is_wr = cpuif_req_is_wr;
    assign decoded_wr_data = cpuif_wr_data;
    assign decoded_wr_biten = cpuif_wr_biten;

    //--------------------------------------------------------------------------
    // Field logic
    //--------------------------------------------------------------------------
    typedef struct {
        struct {
            struct {
                logic [31:0] next;
                logic load_next;
            } d;
        } source_port;
        struct {
            struct {
                logic [31:0] next;
                logic load_next;
            } d;
        } source_ip;
        struct {
            struct {
                logic [31:0] next;
                logic load_next;
            } d;
        } dest_port;
        struct {
            struct {
                logic [31:0] next;
                logic load_next;
            } d;
        } dest_ip;
        struct {
            struct {
                logic next;
                logic load_next;
            } enable;
            struct {
                logic next;
                logic load_next;
            } open;
            struct {
                logic next;
                logic load_next;
            } close;
        } control;
    } field_combo_t;
    field_combo_t field_combo;

    typedef struct {
        struct {
            struct {
                logic [31:0] value;
            } d;
        } source_port;
        struct {
            struct {
                logic [31:0] value;
            } d;
        } source_ip;
        struct {
            struct {
                logic [31:0] value;
            } d;
        } dest_port;
        struct {
            struct {
                logic [31:0] value;
            } d;
        } dest_ip;
        struct {
            struct {
                logic value;
            } enable;
            struct {
                logic value;
            } open;
            struct {
                logic value;
            } close;
        } control;
    } field_storage_t;
    field_storage_t field_storage;

    // Field: tcp_stream_regs.source_port.d
    always_comb begin
        automatic logic [31:0] next_c;
        automatic logic load_next_c;
        next_c = field_storage.source_port.d.value;
        load_next_c = '0;
        if(decoded_reg_strb.source_port && decoded_req_is_wr) begin // SW write
            next_c = (field_storage.source_port.d.value & ~decoded_wr_biten[31:0]) | (decoded_wr_data[31:0] & decoded_wr_biten[31:0]);
            load_next_c = '1;
        end
        field_combo.source_port.d.next = next_c;
        field_combo.source_port.d.load_next = load_next_c;
    end
    always_ff @(posedge clk) begin
        if(rst) begin
            field_storage.source_port.d.value <= 32'h0;
        end else if(field_combo.source_port.d.load_next) begin
            field_storage.source_port.d.value <= field_combo.source_port.d.next;
        end
    end
    assign hwif_out.source_port.d.value = field_storage.source_port.d.value;
    // Field: tcp_stream_regs.source_ip.d
    always_comb begin
        automatic logic [31:0] next_c;
        automatic logic load_next_c;
        next_c = field_storage.source_ip.d.value;
        load_next_c = '0;
        if(decoded_reg_strb.source_ip && decoded_req_is_wr) begin // SW write
            next_c = (field_storage.source_ip.d.value & ~decoded_wr_biten[31:0]) | (decoded_wr_data[31:0] & decoded_wr_biten[31:0]);
            load_next_c = '1;
        end
        field_combo.source_ip.d.next = next_c;
        field_combo.source_ip.d.load_next = load_next_c;
    end
    always_ff @(posedge clk) begin
        if(rst) begin
            field_storage.source_ip.d.value <= 32'h0;
        end else if(field_combo.source_ip.d.load_next) begin
            field_storage.source_ip.d.value <= field_combo.source_ip.d.next;
        end
    end
    assign hwif_out.source_ip.d.value = field_storage.source_ip.d.value;
    // Field: tcp_stream_regs.dest_port.d
    always_comb begin
        automatic logic [31:0] next_c;
        automatic logic load_next_c;
        next_c = field_storage.dest_port.d.value;
        load_next_c = '0;
        if(decoded_reg_strb.dest_port && decoded_req_is_wr) begin // SW write
            next_c = (field_storage.dest_port.d.value & ~decoded_wr_biten[31:0]) | (decoded_wr_data[31:0] & decoded_wr_biten[31:0]);
            load_next_c = '1;
        end
        field_combo.dest_port.d.next = next_c;
        field_combo.dest_port.d.load_next = load_next_c;
    end
    always_ff @(posedge clk) begin
        if(rst) begin
            field_storage.dest_port.d.value <= 32'h0;
        end else if(field_combo.dest_port.d.load_next) begin
            field_storage.dest_port.d.value <= field_combo.dest_port.d.next;
        end
    end
    assign hwif_out.dest_port.d.value = field_storage.dest_port.d.value;
    // Field: tcp_stream_regs.dest_ip.d
    always_comb begin
        automatic logic [31:0] next_c;
        automatic logic load_next_c;
        next_c = field_storage.dest_ip.d.value;
        load_next_c = '0;
        if(decoded_reg_strb.dest_ip && decoded_req_is_wr) begin // SW write
            next_c = (field_storage.dest_ip.d.value & ~decoded_wr_biten[31:0]) | (decoded_wr_data[31:0] & decoded_wr_biten[31:0]);
            load_next_c = '1;
        end
        field_combo.dest_ip.d.next = next_c;
        field_combo.dest_ip.d.load_next = load_next_c;
    end
    always_ff @(posedge clk) begin
        if(rst) begin
            field_storage.dest_ip.d.value <= 32'h0;
        end else if(field_combo.dest_ip.d.load_next) begin
            field_storage.dest_ip.d.value <= field_combo.dest_ip.d.next;
        end
    end
    assign hwif_out.dest_ip.d.value = field_storage.dest_ip.d.value;
    // Field: tcp_stream_regs.control.enable
    always_comb begin
        automatic logic [0:0] next_c;
        automatic logic load_next_c;
        next_c = field_storage.control.enable.value;
        load_next_c = '0;
        if(decoded_reg_strb.control && decoded_req_is_wr) begin // SW write
            next_c = (field_storage.control.enable.value & ~decoded_wr_biten[0:0]) | (decoded_wr_data[0:0] & decoded_wr_biten[0:0]);
            load_next_c = '1;
        end
        field_combo.control.enable.next = next_c;
        field_combo.control.enable.load_next = load_next_c;
    end
    always_ff @(posedge clk) begin
        if(rst) begin
            field_storage.control.enable.value <= 1'h0;
        end else if(field_combo.control.enable.load_next) begin
            field_storage.control.enable.value <= field_combo.control.enable.next;
        end
    end
    assign hwif_out.control.enable.value = field_storage.control.enable.value;
    // Field: tcp_stream_regs.control.open
    always_comb begin
        automatic logic [0:0] next_c;
        automatic logic load_next_c;
        next_c = field_storage.control.open.value;
        load_next_c = '0;
        if(decoded_reg_strb.control && decoded_req_is_wr) begin // SW write
            next_c = (field_storage.control.open.value & ~decoded_wr_biten[1:1]) | (decoded_wr_data[1:1] & decoded_wr_biten[1:1]);
            load_next_c = '1;
        end else if(hwif_in.control.open.hwclr) begin // HW Clear
            next_c = '0;
            load_next_c = '1;
        end
        field_combo.control.open.next = next_c;
        field_combo.control.open.load_next = load_next_c;
    end
    always_ff @(posedge clk) begin
        if(rst) begin
            field_storage.control.open.value <= 1'h0;
        end else if(field_combo.control.open.load_next) begin
            field_storage.control.open.value <= field_combo.control.open.next;
        end
    end
    assign hwif_out.control.open.value = field_storage.control.open.value;
    // Field: tcp_stream_regs.control.close
    always_comb begin
        automatic logic [0:0] next_c;
        automatic logic load_next_c;
        next_c = field_storage.control.close.value;
        load_next_c = '0;
        if(decoded_reg_strb.control && decoded_req_is_wr) begin // SW write
            next_c = (field_storage.control.close.value & ~decoded_wr_biten[2:2]) | (decoded_wr_data[2:2] & decoded_wr_biten[2:2]);
            load_next_c = '1;
        end else if(hwif_in.control.close.hwclr) begin // HW Clear
            next_c = '0;
            load_next_c = '1;
        end
        field_combo.control.close.next = next_c;
        field_combo.control.close.load_next = load_next_c;
    end
    always_ff @(posedge clk) begin
        if(rst) begin
            field_storage.control.close.value <= 1'h0;
        end else if(field_combo.control.close.load_next) begin
            field_storage.control.close.value <= field_combo.control.close.next;
        end
    end
    assign hwif_out.control.close.value = field_storage.control.close.value;
    assign hwif_out.m2s_dma_regs.req = decoded_reg_strb.m2s_dma_regs;
    assign hwif_out.m2s_dma_regs.addr = decoded_addr[4:0];
    assign hwif_out.m2s_dma_regs.req_is_wr = decoded_req_is_wr;
    assign hwif_out.m2s_dma_regs.wr_data = decoded_wr_data;
    assign hwif_out.m2s_dma_regs.wr_biten = decoded_wr_biten;

    //--------------------------------------------------------------------------
    // Write response
    //--------------------------------------------------------------------------
    always_comb begin
        automatic logic wr_ack;
        wr_ack = '0;
        wr_ack |= hwif_in.m2s_dma_regs.wr_ack;
        external_wr_ack = wr_ack;
    end
    assign cpuif_wr_ack = external_wr_ack | (decoded_req & decoded_req_is_wr & ~decoded_strb_is_external);
    // Writes are always granted with no error response
    assign cpuif_wr_err = '0;

    //--------------------------------------------------------------------------
    // Readback
    //--------------------------------------------------------------------------
    logic readback_external_rd_ack_c;
    always_comb begin
        automatic logic rd_ack;
        rd_ack = '0;
        rd_ack |= hwif_in.m2s_dma_regs.rd_ack;
        readback_external_rd_ack_c = rd_ack;
    end

    logic readback_external_rd_ack;

    assign readback_external_rd_ack = readback_external_rd_ack_c;

    logic readback_err;
    logic readback_done;
    logic [31:0] readback_data;

    // Assign readback values to a flattened array
    logic [31:0] readback_array[6];
    assign readback_array[0][31:0] = (decoded_reg_strb.source_port && !decoded_req_is_wr) ? field_storage.source_port.d.value : '0;
    assign readback_array[1][31:0] = (decoded_reg_strb.source_ip && !decoded_req_is_wr) ? field_storage.source_ip.d.value : '0;
    assign readback_array[2][31:0] = (decoded_reg_strb.dest_port && !decoded_req_is_wr) ? field_storage.dest_port.d.value : '0;
    assign readback_array[3][31:0] = (decoded_reg_strb.dest_ip && !decoded_req_is_wr) ? field_storage.dest_ip.d.value : '0;
    assign readback_array[4][0:0] = (decoded_reg_strb.control && !decoded_req_is_wr) ? field_storage.control.enable.value : '0;
    assign readback_array[4][1:1] = (decoded_reg_strb.control && !decoded_req_is_wr) ? field_storage.control.open.value : '0;
    assign readback_array[4][2:2] = (decoded_reg_strb.control && !decoded_req_is_wr) ? field_storage.control.close.value : '0;
    assign readback_array[4][5:3] = (decoded_reg_strb.control && !decoded_req_is_wr) ? hwif_in.control.state.next : '0;
    assign readback_array[4][31:6] = '0;
    assign readback_array[5] = hwif_in.m2s_dma_regs.rd_ack ? hwif_in.m2s_dma_regs.rd_data : '0;

    // Reduce the array
    always_comb begin
        automatic logic [31:0] readback_data_var;
        readback_done = decoded_req & ~decoded_req_is_wr & ~decoded_strb_is_external;
        readback_err = '0;
        readback_data_var = '0;
        for(int i=0; i<6; i++) readback_data_var |= readback_array[i];
        readback_data = readback_data_var;
    end

    assign external_rd_ack = readback_external_rd_ack;
    assign cpuif_rd_ack = readback_done | readback_external_rd_ack;
    assign cpuif_rd_data = readback_data;
    assign cpuif_rd_err = readback_err;
endmodule
